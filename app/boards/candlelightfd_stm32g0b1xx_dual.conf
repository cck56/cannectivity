## app/boards/candlelightfd_stm32g0b1xx_dual.conf
```kconfig
# Copyright (c) 2024-2025 Henrik Brix Andersen <henrik@brixandersen.dk>
# SPDX-License-Identifier: Apache-2.0

CONFIG_CANNECTIVITY_USB_SELF_POWERED=n

# Enable board-specific initialization for STM32G0 option bytes
CONFIG_CANNECTIVITY_BOARD_INIT=y
CONFIG_CANNECTIVITY_BOARD_INIT_STM32G0_OPTION_BYTES=y
```

## app/boards/dualcanfd_g0.conf
```kconfig
CONFIG_CANNECTIVITY_USB_SELF_POWERED=n
CONFIG_CANNECTIVITY_TERMINATION_DEFAULT_ON=n
```

## app/boards/usb2canfdv1_stm32g0b1xx.conf
```kconfig
# Copyright (c) 2025 CANnectivity Project
# SPDX-License-Identifier: Apache-2.0

# Enable board-specific initialization for STM32G0 option bytes
CONFIG_CANNECTIVITY_BOARD_INIT=y
CONFIG_CANNECTIVITY_BOARD_INIT_STM32G0_OPTION_BYTES=y
```

## boards/others/dualcanfd_g0/board.yml
```yaml
board:
  name: dualcanfd_g0
  full_name: DualCAN FD G0
  vendor: others
  socs:
    - name: stm32g0b1xx
```
